## main/Kconfig.projbuild
```kconfig
menu "Project Configuration"

    config BROKER_URL
        string "Broker URL"
        default "mqtt://mqtt.eclipseprojects.io"
        help
            URL of the broker to connect to
    config BROKER_USERNAME
        string "Broker Username"
        default "mqtt"
        help
            Username to login to the broker
    config BROKER_PASSWORD
        string "Broker Password"
        default "mqtt"
        help
            Password to login to the broker
    config SSID
        string "SSID"
        default "__UNDEFINED__"
        help
            Wifi SSID
    config WIFI_PASSWORD 
        string "WiFi Password"
        default "__UNDEFINED__"
        help
            Wifi Password
    config ART_CONVERTER_URL
        string "Art Converter URL"
        default "http://art-converter.example.com"
        help
            URL to reach the art converter proxy service
endmenu
```
